## subsys/bluetooth/services/Kconfig.ancs_c
```kconfig
#
# Copyright (c) 2020 Nordic Semiconductor ASA
#
# SPDX-License-Identifier: LicenseRef-BSD-5-Clause-Nordic
#

menuconfig BT_GATT_ANCS_C
	bool "Apple Notification Center Service client"
	select BT_NRF_SERVICES
	help
	  Enable Apple Notification Center Service client.

if BT_GATT_ANCS_C

config BT_GATT_ANCS_C_CP_BUFF_SIZE
	int "Control Point transmit buffer size"
	default 160
	range 20 65535
	help
	  Transmit buffer size for Control Point characteristic.

module = BT_GATT_ANCS_C
module-str = ANCS Client
source "${ZEPHYR_BASE}/subsys/logging/Kconfig.template.log_config"

endif # BT_GATT_ANCS_C
```
